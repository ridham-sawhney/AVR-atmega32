
//Program on Interrupt: Generate a square wave on PORTB.5 while continuously sending data from PORTC.5 to PORTD.5 
.INCLUDE "M32DEF.INC" 
.ORG 0X0 
JMP MAIN 
.ORG 0X16 
JMP T0_ISR 
 
 
.ORG 0X100 
MAIN: LDI R20, HIGH(RAMEND) 
OUT SPH,R20 
LDI R20, LOW(RAMEND) 
OUT SPL, R20 
 
SBI DDRB,5 
CBI DDRC,5 
SBI DDRD,5 
 
 
LDI R20,(1<<TOIE0) 
OUT TIMSK, R20 
SEI 
 
LDI R20, -32 
OUT TCNT0, R20 
LDI R20,0X01; 
OUT TCCR0,R20 
 
 
HERE: IN R20, PINC 
OUT PORTD, R20 
JMP HERE 
 
.ORG 0X200 
T0_ISR: IN R16, PINB 
LDI R17,0X20 
EOR R16,R17 
OUT PORTB,R16 
LDI R20,1<<TOV0 
OUT TIFR,R20 
LDI R20, -32 
OUT TCNT0,R20 
RETI 
